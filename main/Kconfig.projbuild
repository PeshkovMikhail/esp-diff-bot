## main/Kconfig.projbuild
```kconfig
menu "micro-ROS example-app settings"

    config MICRO_ROS_APP_STACK
        int "Stack the micro-ROS app (Bytes)"
        default 16000
        help
        Stack size in Bytes of the micro-ROS app

    config MICRO_ROS_APP_TASK_PRIO
        int "Priority of the micro-ROS app"
        default 5
        help
        Priority of micro-ros task higher value means higher priority

    config EXAMPLE_FIRMWARE_UPGRADE_URL
        string "firmware upgrade url endpoint"
        default "https://192.168.0.3:8070/hello_world.bin"
        help
            URL of server which hosts the firmware
            image.

    config EXAMPLE_USE_CERT_BUNDLE
        bool "Enable certificate bundle"
        default y
        depends on MBEDTLS_CERTIFICATE_BUNDLE
        help
            Enable trusted root certificate bundle. This approach allows to have
            OTA updates functional with any public server without requirement
            to explicitly add its server certificate.

    config EXAMPLE_FIRMWARE_UPGRADE_URL_FROM_STDIN
        bool
        default y if EXAMPLE_FIRMWARE_UPGRADE_URL = "FROM_STDIN"

    config EXAMPLE_SKIP_COMMON_NAME_CHECK
        bool "Skip server certificate CN fieldcheck"
        default n
        help
            This allows you to skip the validation of OTA server certificate CN field.

    config EXAMPLE_FIRMWARE_UPGRADE_BIND_IF
        bool "Support firmware upgrade bind specified interface"
        default n
        help
            This allows you to bind specified interface in OTA example.

    choice EXAMPLE_FIRMWARE_UPGRADE_BIND_IF_TYPE
        prompt "Choose OTA data bind interface"
        default EXAMPLE_FIRMWARE_UPGRADE_BIND_IF_STA
        depends on EXAMPLE_FIRMWARE_UPGRADE_BIND_IF
        help
            Select which interface type of OTA data go through.

        config EXAMPLE_FIRMWARE_UPGRADE_BIND_IF_STA
            bool "Bind wifi station interface"
            depends on EXAMPLE_CONNECT_WIFI
            help
                Select wifi station interface to pass the OTA data.

        config EXAMPLE_FIRMWARE_UPGRADE_BIND_IF_ETH
            bool "Bind ethernet interface"
            depends on EXAMPLE_CONNECT_ETHERNET
            help
                Select ethernet interface to pass the OTA data.
    endchoice

    config ESP_WIFI_SSID
        string "WiFi SSID"
        default "myssid"
        help
            SSID (network name) for the example to connect to.

    config ESP_WIFI_PASSWORD
        string "WiFi Password"
        default "mypassword"
        help
            WiFi password (WPA or WPA2) for the example to use.

    choice ESP_WIFI_SAE_MODE
        prompt "WPA3 SAE mode selection"
        default ESP_WPA3_SAE_PWE_BOTH
        help
            Select mode for SAE as Hunt and Peck, H2E or both.
        config ESP_WPA3_SAE_PWE_HUNT_AND_PECK
            bool "HUNT AND PECK"
        config ESP_WPA3_SAE_PWE_HASH_TO_ELEMENT
            bool "H2E"
        config ESP_WPA3_SAE_PWE_BOTH
            bool "BOTH"
    endchoice

    config ESP_WIFI_PW_ID
        string "PASSWORD IDENTIFIER"
        depends on  ESP_WPA3_SAE_PWE_HASH_TO_ELEMENT|| ESP_WPA3_SAE_PWE_BOTH
        default ""
        help
            password identifier for SAE H2E

    config ESP_MAXIMUM_RETRY
        int "Maximum retry"
        default 5
        help
            Set the Maximum retry to avoid station reconnecting to the AP unlimited when the AP is really inexistent.

    choice ESP_WIFI_SCAN_AUTH_MODE_THRESHOLD
        prompt "WiFi Scan auth mode threshold"
        default ESP_WIFI_AUTH_WPA2_PSK
        help
            The weakest authmode to accept in the scan mode.
            This value defaults to ESP_WIFI_AUTH_WPA2_PSK incase password is present and ESP_WIFI_AUTH_OPEN is used.
            Please select ESP_WIFI_AUTH_WEP/ESP_WIFI_AUTH_WPA_PSK incase AP is operating in WEP/WPA mode.

        config ESP_WIFI_AUTH_OPEN
            bool "OPEN"
        config ESP_WIFI_AUTH_WEP
            bool "WEP"
        config ESP_WIFI_AUTH_WPA_PSK
            bool "WPA PSK"
        config ESP_WIFI_AUTH_WPA2_PSK
            bool "WPA2 PSK"
        config ESP_WIFI_AUTH_WPA_WPA2_PSK
            bool "WPA/WPA2 PSK"
        config ESP_WIFI_AUTH_WPA3_PSK
            bool "WPA3 PSK"
        config ESP_WIFI_AUTH_WPA2_WPA3_PSK
            bool "WPA2/WPA3 PSK"
        config ESP_WIFI_AUTH_WAPI_PSK
            bool "WAPI PSK"
    endchoice

endmenu
```
